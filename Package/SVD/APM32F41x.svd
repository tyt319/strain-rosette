# APM32F41x register map
File version: 1.0
CPU: CM4 r1p0, little endian, no MPU, no FPU, 3 interrupt priority bits
Registers are 32-bit, read-write, reset 0x0 unless marked. A register's access mark holds for its fields unless they carry their own. Offsets are from the block's base; lines under a group give offsets from that group; [hi:lo] are bit positions; {n}, {i} and the like mark numbered series; 'fields as' and 'values as' point back to an identical list; <NAME> marks a mode.

## Memory map
0x40000000 TMR2 size 0x400 — General purpose timers
0x40000400 TMR3 size 0x400 — General purpose timers
0x40000800 TMR4 size 0x400
0x40000C00 TMR5 size 0x400 — General-purpose-timers
0x40001000 TMR6 size 0x400 — Basic timers
0x40001400 TMR7 size 0x400
0x40001800 TMR12 size 0x400
0x40001C00 TMR13 size 0x400
0x40002000 TMR14 size 0x400
0x40002800 RTC size 0x400 — Real-time clock
0x40002C00 WWDT size 0x400 — Window watchdog
0x40003000 IWDT size 0x400 — Independent watchdog
0x40003400 I2S2ext size 0x400
0x40003800 SPI2 size 0x400
0x40003C00 SPI3 size 0x400
0x40004000 I2S3ext size 0x400
0x40004400 USART2 size 0x400
0x40004800 USART3 size 0x400
0x40004C00 UART4 size 0x400 — Universal synchronous asynchronous receiver transmitter
0x40005000 UART5 size 0x400
0x40005400 I2C1 size 0x400
0x40005800 I2C2 size 0x400
0x40005C00 I2C3 size 0x400 — Inter-integrated circuit
0x40006400 CAN1 size 0x400 — Controller area network
0x40006800 CAN2 size 0x400
0x40007000 PMU size 0x400 — Power control
0x40007400 DAC size 0x400 — Digital-to-analog converter
0x40010000 TMR1 size 0x400 — Advanced-timers
0x40010400 TMR8 size 0x400
0x40011000 USART1 size 0x400
0x40011400 USART6 size 0x400 — Universal synchronous asynchronous receiver transmitter
0x40012000 ADC1 size 0x51 — Analog-to-digital converter
0x40012100 ADC2 size 0x51
0x40012200 ADC3 size 0x51
0x40012300 ADC_CCTRL size 0x400 — ADC Common control registers
0x40012C00 SDIO size 0x400 — Secure digital input/output interface
0x40013000 SPI1 size 0x400 — Serial peripheral interface
0x40013800 SYSCFG size 0x400 — System configuration controller
0x40013C00 EINT size 0x400 — External interrupt/event controller
0x40014000 TMR9 size 0x400 — General purpose timers
0x40014400 TMR10 size 0x400 — General-purpose-timers
0x40014800 TMR11 size 0x400 — General-purpose-timers
0x40020000 GPIOA size 0x400 — General-purpose I/Os
0x40020400 GPIOB size 0x400 — General-purpose I/Os
0x40020800 GPIOC size 0x400
0x40020C00 GPIOD size 0x400
0x40021000 GPIOE size 0x400
0x40021400 GPIOF size 0x400
0x40021800 GPIOG size 0x400
0x40021C00 GPIOH size 0x400
0x40022000 GPIOI size 0x400 — General-purpose I/Os
0x40023000 CRC size 0x400 — Cryptographic processor
0x40023800 RCM size 0x400 — Reset and clock control
0x40023C00 FMC size 0x400 — Flash memory controller
0x40026000 DMA1 size 0x400
0x40026400 DMA2 size 0x400 — DMA controller
0x40028000 Ethernet_MAC size 0x61 — Ethernet: media access control (MAC)
0x40028100 Ethernet_MMC size 0x400 — Ethernet: MAC management counters
0x40028700 Ethernet_PTP size 0x400 — Ethernet: Precision time protocol
0x40029000 Ethernet_DMA size 0x400 — Ethernet: DMA controller operation
0x40040000 OTG_HS1_GLOBAL size 0x131 — USB on the go high speed
0x40040200 OTG_HS2 size 0x200 — USB on the go high speed
0x40040400 OTG_HS1_HOST size 0x400 — USB on the go high speed
0x40040800 OTG_HS1_DEVICE size 0x400 — USB on the go high speed
0x40040E00 OTG_HS1_PWRCLK size 0x3F200 — USB on the go high speed
0x50000000 OTG_FS_GLOBAL size 0x400 — USB on the go full speed
0x50000400 OTG_FS_HOST size 0x400 — USB on the go full speed
0x50000800 OTG_FS_DEVICE size 0x400 — USB on the go full speed
0x50000E00 OTG_FS_PWRCLK size 0x400 — USB on the go full speed
0x50050000 DCI size 0x400 — Digital camera interface
0x50060000 CRYP size 0x400 — Cryptographic processor
0x50060400 HASH size 0x400 — Hash processor
0x50060800 RNG size 0x400 — Random number generator
0x50080000 SM3 size 0x400
0x50080400 SM4 size 0x400
0x500A0000 BN size 0x400 — Big number
0xA0000000 SMC size 0x400 — Static memory controller
0xA0000000 DMC size 0x1000 — Dynamic memory controler
0xE000E100 NVIC size 0x351 — Nested Vectored Interrupt Controller
0xE0042000 DBGMCU size 0x400 — Debug support

## Interrupts
0 WWDG (WWDT) — Window Watchdog interrupt
1 PVD (PMU) — PVD through EINT line detection interrupt
2 TAMP_STAMP (EINT) — Tamper and TimeStamp interrupts through the EINT line
3 RTC_WKUP (RTC) — RTC Wakeup interrupt through the EINT line
4 FLASH (FMC) — Flash global interrupt
5 RCM — RCM global interrupt
6 EINT0 (EINT) — EINT Line0 interrupt
7 EINT1 (EINT) — EINT Line1 interrupt
8 EINT2 (EINT) — EINT Line2 interrupt
9 EINT3 (EINT) — EINT Line3 interrupt
10 EINT4 (EINT) — EINT Line4 interrupt
11 DMA1_STR0 (DMA1) — DMA1 Stream 0 global interrupt
12 DMA1_STR1 (DMA1) — DMA1 Stream 1 global interrupt
13 DMA1_STR2 (DMA1) — DMA1 Stream 2 global interrupt
14 DMA1_STR3 (DMA1) — DMA1 Stream 3 global interrupt
15 DMA1_STR4 (DMA1) — DMA1 Stream 4 global interrupt
16 DMA1_STR5 (DMA1) — DMA1 Stream 5 global interrupt
17 DMA1_STR6 (DMA1) — DMA1 Stream 6 global interrupt
18 ADC (ADC{n} (n=1..3)) — ADC1 global interrupt
19 CAN1_TX (CAN1) — CAN1 TX interrupts
20 CAN1_RX0 (CAN1) — CAN1 RX0 interrupts
21 CAN1_RX1 (CAN1) — CAN1 RX1 interrupts
22 CAN1_SCE (CAN1) — CAN1 SCE interrupt
23 EINT9_5 (EINT) — EINT Line[9:5] interrupts
24 TMR1_BRK_TMR9 (TMR1, TMR9) — TMR1 Break interrupt and TMR9 global interrupt
25 TMR1_UP_TMR10 (TMR1, TMR10) — TMR1 Update interrupt and TMR10 global interrupt
26 TMR1_TRG_COM_TMR11 (TMR1, TMR11) — TMR1 Trigger and Commutation interrupts and TMR11 global interrupt
27 TMR1_CC (TMR1) — TMR1 Capture Compare interrupt
28 TMR2 — TMR2 global interrupt
29 TMR3 — TMR3 global interrupt
30 TMR4 — TMR4 global interrupt
31 I2C1_EV (I2C1) — I2C1 event interrupt
32 I2C1_ER (I2C1) — I2C1 error interrupt
33 I2C2_EV (I2C2) — I2C2 event interrupt
34 I2C2_ER (I2C2) — I2C2 error interrupt
35 SPI1 — SPI1 global interrupt
36 SPI2 — SPI2 global interrupt
37 USART1 — USART1 global interrupt
38 USART2 — USART2 global interrupt
39 USART3 — USART3 global interrupt
40 EINT15_10 (EINT) — EINT Line[15:10] interrupts
41 RTC_Alarm (RTC) — RTC Alarms (A and B) through EINT line interrupt
42 OTG_FS_WKUP (OTG_FS_GLOBAL) — USB On-The-Go FS Wakeup through EINT line interrupt
43 TMR8_BRK_TMR12 (TMR8, TMR12) — TMR8 Break interrupt and TMR12 global interrupt
44 TMR8_UP_TMR13 (TMR8, TMR13) — TMR8 Update interrupt and TMR13 global interrupt
45 TMR8_TRG_COM_TMR14 (TMR8, TMR14) — TMR8 Trigger and Commutation interrupts and TMR14 global interrupt
46 TMR8_CC (TMR8) — TMR8 Capture Compare interrupt
47 DMA1_STR7 (DMA1) — DMA1 Stream 7 global interrupt
48 EMMC (SMC) — EMMC global interrupt
49 SDIO — SDIO global interrupt
50 TMR5 — TMR5 global interrupt
51 SPI3 — SPI3 global interrupt
52 UART4 — UART4 global interrupt
53 UART5 — UART5 global interrupt
54 TMR6_DAC (DAC, TMR6) — TMR6 global interrupt, DAC1 and DAC2 underrun error interrupt
55 TMR7 — TMR7 global interrupt
56 DMA2_STR0 (DMA2) — DMA2 Stream 0 global interrupt
57 DMA2_STR1 (DMA2) — DMA2 Stream 1 global interrupt
58 DMA2_STR2 (DMA2) — DMA2 Stream 2 global interrupt
59 DMA2_STR3 (DMA2) — DMA2 Stream 3 global interrupt
60 DMA2_STR4 (DMA2) — DMA2 Stream 4 global interrupt
61 ETH (Ethernet_MAC) — Ethernet global interrupt
62 ETH_WKUP (Ethernet_MAC) — Ethernet Wakeup through EINT line interrupt
63 CAN2_TX (CAN2) — CAN2 TX interrupts
64 CAN2_RX0 (CAN2) — CAN2 RX0 interrupts
65 CAN2_RX1 (CAN2) — CAN2 RX1 interrupts
66 CAN2_SCE (CAN2) — CAN2 SCE interrupt
67 OTG_FS (OTG_FS_GLOBAL) — USB On The Go FS global interrupt
68 DMA2_STR5 (DMA2) — DMA2 Stream 5 global interrupt
69 DMA2_STR6 (DMA2) — DMA2 Stream 6 global interrupt
70 DMA2_STR7 (DMA2) — DMA2 Stream 7 global interrupt
71 USART6 — USART6 global interrupt
72 I2C3_EV (I2C3) — I2C3 event interrupt
73 I2C3_ER (I2C3) — I2C3 error interrupt
74 OTG_HS1_EP1_OUT (OTG_HS1_GLOBAL) — USB On The Go HS1 End Point 1 Out global interrupt
75 OTG_HS1_EP1_IN (OTG_HS1_GLOBAL) — USB On The Go HS1 End Point 1 In global interrupt
76 OTG_HS1_WKUP (OTG_HS1_GLOBAL) — USB On The Go HS1 Wakeup through EINT interrupt
77 OTG_HS1 (OTG_HS1_GLOBAL) — USB On The Go HS1 global interrupt
78 DCI — DCI global interrupt
79 CRYP — CRYP crypto global interrupt
80 HASH_RNG (HASH) — Hash and Rng global interrupt
81 FPU (RNG) — FPU interrupt
82 SM3 — SM3 global interrupt
83 SM4 — SM4 global interrupt
84 BN — BN global interrupt
